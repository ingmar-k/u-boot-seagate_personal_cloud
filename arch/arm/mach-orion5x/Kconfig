## arch/arm/mach-orion5x/Kconfig
```kconfig
if ORION5X

choice
	prompt "Marvell Orion board select"
	optional

config TARGET_EDMINIV2
	bool "LaCie Ethernet Disk mini V2"
	select SUPPORT_SPL

config TARGET_KUROPRO
	bool "Buffalo Kurobox Pro"
	select CMD_POWEROFF

config TARGET_LSGL
	bool "Buffalo Linkstation Pro"
	select CMD_POWEROFF

endchoice

config SYS_SOC
	default "orion5x"

source "board/LaCie/edminiv2/Kconfig"
source "board/buffalo/lsgl/Kconfig"

endif
```

## board/buffalo/lsgl/Kconfig
```kconfig
if TARGET_KUROPRO || TARGET_LSGL

config SYS_BOARD
	default "lsgl"

config SYS_VENDOR
	default "buffalo"

config SYS_CONFIG_NAME
	default "lsgl"

endif
```

## board/cloudengines/pogo/Kconfig
```kconfig
if TARGET_POGO1 || TARGET_POGO2 || TARGET_POGO4 || TARGET_POGOM || TARGET_SHEEVA

config SYS_BOARD
	default "pogo"

config SYS_VENDOR
	default "cloudengines"

config SYS_CONFIG_NAME
	default "pogo"

endif
```

## configs/kuropro_defconfig
```kconfig
CONFIG_ARM=y
CONFIG_ORION5X=y
CONFIG_TARGET_KUROPRO=y
CONFIG_SYS_EXTRA_OPTIONS="SYS_ROMBOOT"
CONFIG_SYS_PROMPT="KUROPRO> "
CONFIG_SYS_NS16550=y

# CONFIG_BOOTM_NETBSD is not set
# CONFIG_BOOTM_PLAN9 is not set
# CONFIG_BOOTM_RTEMS is not set
# CONFIG_BOOTM_VXWORKS is not set

# CONFIG_CMD_CRC32 is not set
# CONFIG_CMD_EXPORTENV is not set
# CONFIG_CMD_IMPORTENV is not set

# CONFIG_CMD_BDI is not set
# CONFIG_CMD_ECHO is not set
# CONFIG_CMD_FPGA is not set
# CONFIG_CMD_ITEST is not set
# CONFIG_CMD_IMLS is not set
# CONFIG_CMD_LOADB is not set
# CONFIG_CMD_LOADS is not set
# CONFIG_CMD_MISC is not set
# CONFIG_CMD_NFS is not set
# CONFIG_CMD_SETGETDCR is not set
# CONFIG_CMD_SOURCE is not set
# CONFIG_CMD_XIMG is not set

# CONFIG_CMD_ELF is not set
# CONFIG_CMD_SETEXPR is not set

# CONFIG_REGEX is not set
```

## configs/kuropro_nand_defconfig
```kconfig
CONFIG_ARM=y
CONFIG_ORION5X=y
CONFIG_TARGET_KUROPRO=y
CONFIG_SYS_EXTRA_OPTIONS="SYS_RAMBOOT,ENV_IS_IN_NAND"
CONFIG_SYS_PROMPT="KUROPRO> "
CONFIG_SYS_NS16550=y
```

## configs/kuropro_ram_defconfig
```kconfig
CONFIG_ARM=y
CONFIG_ORION5X=y
CONFIG_TARGET_KUROPRO=y
CONFIG_SYS_EXTRA_OPTIONS="SYS_RAMBOOT"
CONFIG_SYS_PROMPT="KUROPRO> "
CONFIG_SYS_NS16550=y
```

## configs/ls420_defconfig
```kconfig
CONFIG_ARM=y
CONFIG_ARCH_MVEBU=y
CONFIG_SYS_MALLOC_F_LEN=0x2000
CONFIG_TARGET_LS420=y
CONFIG_SPL_SYS_MALLOC_SIMPLE=y
CONFIG_DEFAULT_DEVICE_TREE="armada-370-buffalo-ls421de"
CONFIG_SPL=y
CONFIG_SYS_PROMPT="LS420> "
# CONFIG_CMD_IMLS is not set
CONFIG_SPL_OF_TRANSLATE=y
CONFIG_SPI_FLASH=y
CONFIG_SPI_FLASH_MACRONIX=y
CONFIG_SYS_NS16550=y
CONFIG_OF_LIBFDT=y
```

## configs/ls440_defconfig
```kconfig
CONFIG_ARM=y
CONFIG_ARCH_MVEBU=y
CONFIG_SYS_MALLOC_F_LEN=0x2000
CONFIG_TARGET_LS440=y
CONFIG_SPL_SYS_MALLOC_SIMPLE=y
CONFIG_DEFAULT_DEVICE_TREE="armada-370-buffalo-ls441de"
CONFIG_SPL=y
CONFIG_SYS_PROMPT="LS440> "
# CONFIG_CMD_IMLS is not set
CONFIG_SPL_OF_TRANSLATE=y
CONFIG_SPI_FLASH=y
CONFIG_SPI_FLASH_MACRONIX=y
CONFIG_SYS_NS16550=y
CONFIG_OF_LIBFDT=y
```

## configs/lsgl_ram_defconfig
```kconfig
CONFIG_ARM=y
CONFIG_ORION5X=y
CONFIG_TARGET_LSGL=y
CONFIG_SYS_EXTRA_OPTIONS="SYS_RAMBOOT"
CONFIG_SYS_PROMPT="LSGL> "
CONFIG_SYS_NS16550=y
```

## configs/pogo2_defconfig
```kconfig
CONFIG_ARM=y
CONFIG_KIRKWOOD=y
CONFIG_TARGET_POGO2=y
CONFIG_SYS_EXTRA_OPTIONS="POGO2"
CONFIG_SYS_PROMPT="POGO2> "
# CONFIG_CMD_IMLS is not set
CONFIG_SYS_NS16550=y
CONFIG_OF_LIBFDT=y
```

## configs/pogo4_defconfig
```kconfig
CONFIG_ARM=y
CONFIG_KIRKWOOD=y
CONFIG_TARGET_POGO4=y
CONFIG_SYS_EXTRA_OPTIONS="POGO4"
CONFIG_SYS_PROMPT="POGO4> "
# CONFIG_CMD_IMLS is not set
CONFIG_SYS_NS16550=y
CONFIG_OF_LIBFDT=y
```

## configs/pogom_defconfig
```kconfig
CONFIG_ARM=y
CONFIG_KIRKWOOD=y
CONFIG_TARGET_POGOM=y
CONFIG_SYS_EXTRA_OPTIONS="POGOM"
CONFIG_SYS_PROMPT="POGOM> "
# CONFIG_CMD_IMLS is not set
CONFIG_SYS_NS16550=y
CONFIG_OF_LIBFDT=y
```

## configs/sheeva_defconfig
```kconfig
CONFIG_ARM=y
CONFIG_KIRKWOOD=y
CONFIG_TARGET_SHEEVA=y
CONFIG_SYS_EXTRA_OPTIONS="SHEEVA"
CONFIG_SYS_PROMPT="SHEEVA> "
# CONFIG_CMD_IMLS is not set
CONFIG_SYS_NS16550=y
CONFIG_OF_LIBFDT=y
```
